.FontDataDefault
	word	$0000,$0000,$0000,$0000,$0000,$0000,$0000,$0000 ; $20  
	word	$2000,$2000,$2000,$2000,$0000,$0000,$2000,$0000 ; $21 !
	word	$5000,$5000,$5000,$0000,$0000,$0000,$0000,$0000 ; $22 "
	word	$5000,$5000,$f800,$5000,$f800,$5000,$5000,$0000 ; $23 #
	word	$2000,$7800,$a000,$7000,$2800,$f000,$2000,$0000 ; $24 $
	word	$c000,$c800,$1000,$2000,$4000,$9800,$1800,$0000 ; $25 %
	word	$6000,$9000,$a000,$4000,$a800,$9000,$6800,$0000 ; $26 &
	word	$6000,$2000,$4000,$0000,$0000,$0000,$0000,$0000 ; $27 '
	word	$1000,$2000,$4000,$4000,$4000,$2000,$1000,$0000 ; $28 (
	word	$4000,$2000,$1000,$1000,$1000,$2000,$4000,$0000 ; $29 )
	word	$0000,$2000,$a800,$7000,$a800,$2000,$0000,$0000 ; $2a *
	word	$0000,$2000,$2000,$f800,$2000,$2000,$0000,$0000 ; $2b +
	word	$0000,$0000,$0000,$0000,$6000,$2000,$4000,$0000 ; $2c ,
	word	$0000,$0000,$0000,$f800,$0000,$0000,$0000,$0000 ; $2d -
	word	$0000,$0000,$0000,$0000,$0000,$6000,$6000,$0000 ; $2e .
	word	$0000,$0800,$1000,$2000,$4000,$8000,$0000,$0000 ; $2f /
	word	$7000,$8800,$9800,$a800,$c800,$8800,$7000,$0000 ; $30 0
	word	$2000,$6000,$2000,$2000,$2000,$2000,$7000,$0000 ; $31 1
	word	$7000,$8800,$0800,$1000,$2000,$4000,$f800,$0000 ; $32 2
	word	$f800,$1000,$2000,$1000,$0800,$8800,$7000,$0000 ; $33 3
	word	$1000,$3000,$5000,$9000,$f800,$1000,$1000,$0000 ; $34 4
	word	$f800,$8000,$f000,$0800,$0800,$8800,$7000,$0000 ; $35 5
	word	$3000,$4000,$8000,$f000,$8800,$8800,$7000,$0000 ; $36 6
	word	$f800,$8800,$0800,$1000,$2000,$2000,$2000,$0000 ; $37 7
	word	$7000,$8800,$8800,$7000,$8800,$8800,$7000,$0000 ; $38 8
	word	$7000,$8800,$8800,$7800,$0800,$1000,$6000,$0000 ; $39 9
	word	$0000,$6000,$6000,$0000,$6000,$6000,$0000,$0000 ; $3a :
	word	$0000,$6000,$6000,$0000,$6000,$2000,$4000,$0000 ; $3b ;
	word	$1000,$2000,$4000,$8000,$4000,$2000,$1000,$0000 ; $3c <
	word	$0000,$0000,$f800,$0000,$f800,$0000,$0000,$0000 ; $3d =
	word	$4000,$2000,$1000,$0800,$1000,$2000,$4000,$0000 ; $3e >
	word	$7000,$8800,$0800,$1000,$2000,$0000,$2000,$0000 ; $3f ?
	word	$7000,$8800,$0800,$6800,$a800,$a800,$7000,$0000 ; $40 @
	word	$7000,$8800,$8800,$8800,$f800,$8800,$8800,$0000 ; $41 A
	word	$f000,$8800,$8800,$f000,$8800,$8800,$f000,$0000 ; $42 B
	word	$7000,$8800,$8000,$8000,$8000,$8800,$7000,$0000 ; $43 C
	word	$e000,$9000,$8800,$8800,$8800,$9000,$e000,$0000 ; $44 D
	word	$f800,$8000,$8000,$f000,$8000,$8000,$f800,$0000 ; $45 E
	word	$f800,$8000,$8000,$f000,$8000,$8000,$8000,$0000 ; $46 F
	word	$7000,$8800,$8000,$b800,$8800,$8800,$7800,$0000 ; $47 G
	word	$8800,$8800,$8800,$f800,$8800,$8800,$8800,$0000 ; $48 H
	word	$7000,$2000,$2000,$2000,$2000,$2000,$7000,$0000 ; $49 I
	word	$3800,$1000,$1000,$1000,$1000,$9000,$6000,$0000 ; $4a J
	word	$8800,$9000,$a000,$c000,$a000,$9000,$8800,$0000 ; $4b K
	word	$8000,$8000,$8000,$8000,$8000,$8000,$f800,$0000 ; $4c L
	word	$8800,$d800,$a800,$a800,$8800,$8800,$8800,$0000 ; $4d M
	word	$8800,$8800,$c800,$a800,$9800,$8800,$8800,$0000 ; $4e N
	word	$7000,$8800,$8800,$8800,$8800,$8800,$7000,$0000 ; $4f O
	word	$f000,$8800,$8800,$f000,$8000,$8000,$8000,$0000 ; $50 P
	word	$7000,$8800,$8800,$8800,$a800,$9000,$6800,$0000 ; $51 Q
	word	$f000,$8800,$8800,$f000,$a000,$9000,$8800,$0000 ; $52 R
	word	$7800,$8000,$8000,$7000,$0800,$0800,$f000,$0000 ; $53 S
	word	$f800,$2000,$2000,$2000,$2000,$2000,$2000,$0000 ; $54 T
	word	$8800,$8800,$8800,$8800,$8800,$8800,$7000,$0000 ; $55 U
	word	$8800,$8800,$8800,$8800,$8800,$5000,$2000,$0000 ; $56 V
	word	$8800,$8800,$8800,$a800,$a800,$a800,$5000,$0000 ; $57 W
	word	$8800,$8800,$5000,$2000,$5000,$8800,$8800,$0000 ; $58 X
	word	$8800,$8800,$8800,$5000,$2000,$2000,$2000,$0000 ; $59 Y
	word	$f800,$0800,$1000,$2000,$4000,$8000,$f800,$0000 ; $5a Z
	word	$e000,$8000,$8000,$8000,$8000,$8000,$e000,$0000 ; $5b [
	word	$0000,$8000,$4000,$2000,$1000,$0800,$0000,$0000 ; $5c \
	word	$7000,$1000,$1000,$1000,$1000,$1000,$7000,$0000 ; $5d ]
	word	$2000,$5000,$8800,$0000,$0000,$0000,$0000,$0000 ; $5e ^
	word	$0000,$0000,$0000,$0000,$0000,$0000,$f800,$0000 ; $5f _
	word	$4000,$2000,$1000,$0000,$0000,$0000,$0000,$0000 ; $60 `
	word	$0000,$0000,$7000,$0800,$7800,$8800,$7800,$0000 ; $61 a
	word	$8000,$8000,$b000,$c800,$8800,$8800,$f000,$0000 ; $62 b
	word	$0000,$0000,$7000,$8000,$8000,$8800,$7000,$0000 ; $63 c
	word	$0800,$0800,$6800,$9800,$8800,$8800,$7800,$0000 ; $64 d
	word	$0000,$0000,$7000,$8800,$f800,$8000,$7000,$0000 ; $65 e
	word	$3000,$4800,$4000,$e000,$4000,$4000,$4000,$0000 ; $66 f
	word	$0000,$7800,$8800,$8800,$7800,$0800,$7000,$0000 ; $67 g
	word	$8000,$8000,$b000,$c800,$8800,$8800,$8800,$0000 ; $68 h
	word	$2000,$0000,$6000,$2000,$2000,$2000,$7000,$0000 ; $69 i
	word	$1000,$0000,$3000,$1000,$1000,$9000,$6000,$0000 ; $6a j
	word	$8000,$8000,$9000,$a000,$c000,$a000,$9000,$0000 ; $6b k
	word	$6000,$2000,$2000,$2000,$2000,$2000,$7000,$0000 ; $6c l
	word	$0000,$0000,$d000,$a800,$a800,$8800,$8800,$0000 ; $6d m
	word	$0000,$0000,$b000,$c800,$8800,$8800,$8800,$0000 ; $6e n
	word	$0000,$0000,$7000,$8800,$8800,$8800,$7000,$0000 ; $6f o
	word	$0000,$0000,$f000,$8800,$f000,$8000,$8000,$0000 ; $70 p
	word	$0000,$0000,$6800,$9800,$7800,$0800,$0800,$0000 ; $71 q
	word	$0000,$0000,$b000,$c800,$8000,$8000,$8000,$0000 ; $72 r
	word	$0000,$0000,$7000,$8000,$7000,$0800,$f000,$0000 ; $73 s
	word	$4000,$4000,$e000,$4000,$4000,$4800,$3000,$0000 ; $74 t
	word	$0000,$0000,$8800,$8800,$8800,$9800,$6800,$0000 ; $75 u
	word	$0000,$0000,$8800,$8800,$8800,$5000,$2000,$0000 ; $76 v
	word	$0000,$0000,$8800,$a800,$a800,$a800,$5000,$0000 ; $77 w
	word	$0000,$0000,$8800,$5000,$2000,$5000,$8800,$0000 ; $78 x
	word	$0000,$0000,$8800,$8800,$7800,$0800,$7000,$0000 ; $79 y
	word	$0000,$0000,$f800,$1000,$2000,$4000,$f800,$0000 ; $7a z
	word	$1000,$2000,$2000,$4000,$2000,$2000,$1000,$0000 ; $7b {
	word	$2000,$2000,$2000,$2000,$2000,$2000,$2000,$0000 ; $7c |
	word	$4000,$2000,$2000,$1000,$2000,$2000,$4000,$0000 ; $7d }
	word	$5000,$a800,$5000,$a800,$5000,$a800,$5000,$0000 ; $7e ~
	word	$fc00,$fc00,$fc00,$fc00,$fc00,$fc00,$fc00,$0000 ; $7f 
