;
;	Automatically generated.
;
.KeyboardMapping
	byte 49,50,51,52,53,54,55,56,57,48,45,61,8,0,0,0        ; Bit 0
	byte 9,113,119,101,114,116,121,117,105,111,112,91,93,0,0,0 ; Bit 1
	byte 97,115,100,102,103,104,106,107,108,59,39,35,13,0,0,0 ; Bit 2
	byte 32,92,122,120,99,118,98,110,109,44,46,47,0,0,0,0   ; Bit 3
	byte 240,241,242,243,244,245,0,0,0,0,0,0,0,0,0,0        ; Bit 4
	byte 1,2,3,4,0,0,0,0,0,0,0,0,0,0,0,0                    ; Bit 5

.ShiftTable
	byte	 64, 39 ; ' -> @
	byte	 60, 44 ; , -> <
	byte	 95, 45 ; - -> _
	byte	 62, 46 ; . -> >
	byte	 63, 47 ; / -> ?
	byte	 41, 48 ; 0 -> )
	byte	 33, 49 ; 1 -> !
	byte	 34, 50 ; 2 -> "
	byte	 35, 51 ; 3 -> #
	byte	 36, 52 ; 4 -> $
	byte	 37, 53 ; 5 -> %
	byte	 94, 54 ; 6 -> ^
	byte	 38, 55 ; 7 -> &
	byte	 42, 56 ; 8 -> *
	byte	 40, 57 ; 9 -> (
	byte	 58, 59 ; ; -> :
	byte	 43, 61 ; = -> +
	byte	123, 91 ; [ -> {
	byte	125, 93 ; ] -> }
	byte	 0,0

