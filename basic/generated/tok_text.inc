;
;	Automatically generated
;
.TokeniserWords
	word	$0902,$4265,$6016                ; $3200 MOV
	word	$0902,$40ac,$600d                ; $3201 LDM
	word	$0902,$4333,$600d                ; $3202 STM
	word	$0902,$40a1,$6004                ; $3203 ADD
	word	$0902,$40a1,$6003                ; $3204 ADC
	word	$0902,$435b,$6002                ; $3205 SUB
	word	$0102,$4231,$6004                ; $2206 AND
	word	$0102,$4270,$6012                ; $2207 XOR
	word	$0902,$4355,$632c                ; $3208 MULT
	word	$0902,$426a,$6012                ; $3209 ROR
	word	$0902,$42d2,$600c                ; $320a BRL
	word	$0902,$41cb,$62ad                ; $320b SKEQ
	word	$0902,$41cb,$60d6                ; $320c SKNE
	word	$0902,$41cb,$60db                ; $320d SKSE
	word	$0902,$41cb,$6243                ; $320e SKSN
	word	$0902,$41cb,$620b                ; $320f SKCM
	word	$0e02,$41e3,$6012                ; $3c10 CLR
	word	$0e02,$4212,$6010                ; $3c11 JMP
	word	$0e02,$4302,$6012                ; $3c12 JSR
	word	$0e02,$40da,$6014                ; $3c13 RET
	word	$0e02,$41cb,$601a                ; $3c14 SKZ
	word	$0e02,$41cb,$641e                ; $3c15 SKNZ
	word	$0e02,$41cb,$6010                ; $3c16 SKP
	word	$0e02,$41cb,$600d                ; $3c17 SKM
	word	$0e02,$41cb,$6003                ; $3c18 SKC
	word	$0e02,$41cb,$6086                ; $3c19 SKNC
	word	$0e02,$41cb,$60cf                ; $3c1a SKGE
	word	$0e02,$41cb,$632c                ; $3c1b SKLT
	word	$0e02,$4358,$6153                ; $3c1c PUSH
	word	$0e02,$4268,$6010                ; $3c1d POP
	word	$0e02,$425b,$60cc                ; $3c1e CODE
	word	$0e02,$426f,$60b2                ; $3c1f WORD
	word	$0e01,$802e                      ; $3c20 .
	word	$0101,$62df                      ; $2221 OR
	word	$0201,$803e                      ; $2422 >
	word	$0201,$bd3e                      ; $2423 >=
	word	$0201,$803c                      ; $2424 <
	word	$0201,$bd3c                      ; $2425 <=
	word	$0201,$803d                      ; $2426 =
	word	$0201,$be3c                      ; $2427 <>
	word	$0301,$be3e                      ; $2628 >>
	word	$0301,$bc3c                      ; $2629 <<
	word	$0401,$802b                      ; $282a +
	word	$0401,$802d                      ; $282b -
	word	$0501,$802a                      ; $2a2c *
	word	$0501,$802f                      ; $2a2d /
	word	$0502,$4265,$6004                ; $2a2e MOD
	word	$0601,$8021                      ; $2c2f !
	word	$0801,$8040                      ; $3030 @
	word	$0801,$8028                      ; $3031 (
	word	$0801,$8026                      ; $3032 &
	word	$0801,$8025                      ; $3033 %
	word	$0801,$ffff                      ; $3034 |CONSTSHIFT
	word	$0802,$4851,$6813                ; $3035 ABS(
	word	$0803,$49e1,$4a64,$6803          ; $3036 ALLOC(
	word	$0802,$4af9,$6803                ; $3037 ASC(
	word	$0802,$5943,$7812                ; $3038 CHR$(
	word	$0803,$4bc5,$4b01,$6b0c          ; $3039 EXISTS(
	word	$0803,$402e,$4304,$6005          ; $303a FALSE
	word	$0803,$4b75,$4a35,$6814          ; $303b EVENT(
	word	$0802,$48cf,$6814                ; $303c GET(
	word	$0802,$58cf,$7814                ; $303d GET$(
	word	$0802,$4970,$6814                ; $303e HIT(
	word	$0803,$4a39,$48d3,$6819          ; $303f INKEY(
	word	$0803,$5a39,$58d3,$7819          ; $3040 INKEY$(
	word	$0803,$4a39,$4a68,$6b32          ; $3041 INPORT(
	word	$0805,$4b01,$4a55,$4a1d,$48ca,$6812 ; $3042 IS.NUMBER(
	word	$0802,$4a62,$6bd9                ; $3043 JOYX(
	word	$0802,$4a62,$6c01                ; $3044 JOYY(
	word	$0802,$4a62,$6869                ; $3045 JOYB(
	word	$0802,$48d3,$6819                ; $3046 KEY(
	word	$0802,$58d4,$7b26                ; $3047 LEFT$(
	word	$0802,$48d4,$680e                ; $3048 LEN(
	word	$0803,$5a64,$58df,$7812          ; $3049 LOWER$(
	word	$0802,$5975,$7804                ; $304a MID$(
	word	$0802,$4835,$6818                ; $304b MAX(
	word	$0802,$4975,$680e                ; $304c MIN(
	word	$0802,$4266,$6014                ; $304d NOT
	word	$0802,$4038,$60cf                ; $304e PAGE
	word	$0802,$48d8,$69bd                ; $304f PEEK(
	word	$0803,$4b59,$48d1,$6814          ; $3050 QUIET(
	word	$0803,$597a,$5947,$7814          ; $3051 RIGHT$(
	word	$0802,$4a42,$6804                ; $3052 RND(
	word	$0802,$4a92,$680c                ; $3053 RPL(
	word	$0802,$492b,$680e                ; $3054 SGN(
	word	$0804,$4a93,$497a,$48dc,$6be5    ; $3055 SPRITE.X(
	word	$0804,$4a93,$497a,$48dc,$6c0d    ; $3056 SPRITE.Y(
	word	$0806,$4a93,$497a,$48dc,$498d,$48fe,$680f ; $3057 SPRITE.INFO(
	word	$0802,$5b33,$7812                ; $3058 STR$(
	word	$0803,$4bfb,$4b83,$6ad1          ; $3059 SYSVAR(
	word	$0803,$497c,$48d5,$6812          ; $305a TIMER(
	word	$0802,$42e4,$60dd                ; $305b TRUE
	word	$0803,$5a95,$58d8,$7812          ; $305c UPPER$(
	word	$0802,$483e,$680c                ; $305d VAL(
	word	$0803,$48d4,$4926,$6954          ; $305e LENGTH(
	word	$0803,$483a,$48ae,$6a17          ; $305f RANDOM(
	word	$0805,$5a6c,$5b1d,$5ae4,$5a39,$7807 ; $3060 TO.STRING$(
	word	$0805,$4a6c,$4a55,$4a1d,$48ca,$6812 ; $3061 TO.NUMBER(
	word	$0802,$497b,$6a37                ; $3062 SIGN(
	word	$0901,$8023                      ; $3263 #
	word	$0901,$8029                      ; $3264 )
	word	$0901,$802c                      ; $3265 ,
	word	$0901,$803b                      ; $3266 ;
	word	$0901,$626c                      ; $3267 TO
	word	$0902,$4333,$6285                ; $3268 STEP
	word	$0901,$805e                      ; $3269 ^
	word	$0f02,$425e,$6012                ; $3e6a FOR
	word	$0f01,$60f9                      ; $3e6b IF
	word	$0f03,$40da,$40d8,$6321          ; $3e6c REPEAT
	word	$0f03,$4157,$41e9,$6005          ; $3e6d WHILE
	word	$0f02,$42e0,$6087                ; $3e6e PROC
	word	$0f02,$402b,$60db                ; $3e6f CASE
	word	$0d03,$4235,$416c,$6006          ; $3a70 ENDIF
	word	$0d02,$40d6,$6338                ; $3a71 NEXT
	word	$0d02,$4154,$6235                ; $3a72 THEN
	word	$0d03,$4245,$417c,$600c          ; $3a73 UNTIL
	word	$0d02,$40df,$60ae                ; $3a74 WEND
	word	$0d04,$4235,$4284,$426a,$6003    ; $3a75 ENDPROC
	word	$0d04,$4235,$407c,$42f9,$6005    ; $3a76 ENDCASE
	word	$0e01,$8027                      ; $3c77 '
	word	$0e01,$803a                      ; $3c78 :
	word	$0e01,$803f                      ; $3c79 ?
	word	$0e03,$40f1,$40dc,$6012          ; $3c7a AFTER
	word	$0e03,$42f9,$40db,$6332          ; $3c7b ASSERT
	word	$0e02,$41e2,$6329                ; $3c7c BLIT
	word	$0e02,$402b,$61ec                ; $3c7d CALL
	word	$0e03,$402b,$4086,$61e5          ; $3c7e CANCEL
	word	$0e03,$41e3,$402d,$6012          ; $3c7f CLEAR
	word	$0e02,$41e3,$6013                ; $3c80 CLS
	word	$0e04,$425b,$423e,$407d,$6014    ; $3c81 CONNECT
	word	$0e03,$42d3,$4245,$6143          ; $3c82 CRUNCH
	word	$0e03,$434b,$430a,$62df          ; $3c83 CURSOR
	word	$0e03,$434b,$4382,$6005          ; $3c84 CURVE
	word	$0e04,$40cc,$402e,$41f5,$6014    ; $3c85 DEFAULT
	word	$0e02,$416c,$600d                ; $3c86 DIM
	word	$0e02,$416c,$6012                ; $3c87 DIR
	word	$0e02,$42d4,$6399                ; $3c88 DRAW
	word	$0e04,$41e5,$4174,$4308,$6005    ; $3c89 ELLIPSE
	word	$0e02,$41e5,$60db                ; $3c8a ELSE
	word	$0e02,$4235,$6004                ; $3c8b END
	word	$0e03,$4375,$42d5,$6019          ; $3c8c EVERY
	word	$0e02,$41be,$63ed                ; $3c8d FKEY
	word	$0e02,$41e6,$6289                ; $3c8e FLIP
	word	$0e03,$42d6,$4209,$6005          ; $3c8f FRAME
	word	$0e03,$425f,$435b,$6002          ; $3c90 GOSUB
	word	$0e02,$425f,$626c                ; $3c91 GOTO
	word	$0e02,$4239,$600b                ; $3c92 INK
	word	$0e03,$4239,$4358,$6014          ; $3c93 INPUT
	word	$0e02,$40d4,$6014                ; $3c94 LET
	word	$0e02,$4174,$60d6                ; $3c95 LINE
	word	$0e02,$4174,$6333                ; $3c96 LIST
	word	$0e02,$4264,$60a1                ; $3c97 LOAD
	word	$0e03,$4264,$402b,$600c          ; $3c98 LOCAL
	word	$0e02,$4265,$600e                ; $3c99 MON
	word	$0e02,$4265,$60de                ; $3c9a MOVE
	word	$0e02,$40d6,$6017                ; $3c9b NEW
	word	$0e02,$41ef,$6004                ; $3c9c OLD
	word	$0e01,$623f                      ; $3c9d ON
	word	$0e04,$4357,$4294,$42df,$6014    ; $3c9e OUTPORT
	word	$0e04,$4038,$40d4,$4334,$6005    ; $3c9f PALETTE
	word	$0e03,$4038,$40d8,$6012          ; $3ca0 PAPER
	word	$0e02,$41f0,$632f                ; $3ca1 PLOT
	word	$0e02,$4268,$60d3                ; $3ca2 POKE
	word	$0e03,$42e0,$4239,$6014          ; $3ca3 PRINT
	word	$0e02,$40da,$6323                ; $3ca4 RECT
	word	$0e02,$40da,$600d                ; $3ca5 REM
	word	$0e03,$40da,$4356,$600d          ; $3ca6 RENUM
	word	$0e03,$40da,$435c,$6242          ; $3ca7 RETURN
	word	$0e02,$435a,$600e                ; $3ca8 RUN
	word	$0e02,$403b,$60de                ; $3ca9 SAVE
	word	$0e03,$408b,$40da,$6235          ; $3caa SCREEN
	word	$0e03,$41f3,$40a9,$6005          ; $3cab SLIDE
	word	$0e03,$426b,$4245,$6004          ; $3cac SOUND
	word	$0e03,$4293,$417a,$60dc          ; $3cad SPRITE
	word	$0e02,$4333,$628f                ; $3cae STOP
	word	$0e02,$43fb,$6013                ; $3caf SYS
	word	$0e02,$40dc,$6338                ; $3cb0 TEXT
	word	$0e02,$417c,$60d4                ; $3cb1 TILE
	word	$0e02,$403f,$6329                ; $3cb2 WAIT
	word	$0e02,$4157,$6235                ; $3cb3 WHEN
	word	$0000
