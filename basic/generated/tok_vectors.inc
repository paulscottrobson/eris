;
;	Automatically generated
;
.TokenVectors
	word	Dummy14                  ; $3200 MOV
	word	Dummy13                  ; $3201 LDM
	word	Dummy22                  ; $3202 STM
	word	Dummy11                  ; $3203 ADD
	word	Dummy10                  ; $3204 ADC
	word	Dummy23                  ; $3205 SUB
	word	BinaryOp_And             ; $2206 AND
	word	BinaryOp_Xor             ; $2207 XOR
	word	Dummy15                  ; $3208 MULT
	word	Dummy16                  ; $3209 ROR
	word	Dummy12                  ; $320a BRL
	word	Dummy18                  ; $320b SKEQ
	word	Dummy19                  ; $320c SKNE
	word	Dummy20                  ; $320d SKSE
	word	Dummy21                  ; $320e SKSN
	word	Dummy17                  ; $320f SKCM
	word	Macro_Clr                ; $3c10 CLR
	word	Macro_Jmp                ; $3c11 JMP
	word	Macro_Jsr                ; $3c12 JSR
	word	Macro_Ret                ; $3c13 RET
	word	Macro_Skz                ; $3c14 SKZ
	word	Macro_Sknz               ; $3c15 SKNZ
	word	Macro_Skp                ; $3c16 SKP
	word	Macro_Skm                ; $3c17 SKM
	word	Macro_Skc                ; $3c18 SKC
	word	Macro_Sknc               ; $3c19 SKNC
	word	Macro_Skge               ; $3c1a SKGE
	word	Macro_Sklt               ; $3c1b SKLT
	word	Macro_Push               ; $3c1c PUSH
	word	Macro_Pop                ; $3c1d POP
	word	Command_Code             ; $3c1e CODE
	word	Command_Word             ; $3c1f WORD
	word	Command_Label            ; $3c20 .
	word	BinaryOp_Or              ; $2221 OR
	word	BinaryOp_Greater         ; $2422 >
	word	BinaryOp_GreaterEqual    ; $2423 >=
	word	BinaryOp_Less            ; $2424 <
	word	BinaryOp_LessEqual       ; $2425 <=
	word	BinaryOp_Equal           ; $2426 =
	word	BinaryOp_NotEqual        ; $2427 <>
	word	BinaryOp_Shr             ; $2628 >>
	word	BinaryOp_Shl             ; $2629 <<
	word	BinaryOp_Add             ; $282a +
	word	BinaryOp_Sub             ; $282b -
	word	BinaryOp_Mult            ; $2a2c *
	word	BinaryOp_Divide          ; $2a2d /
	word	BinaryOp_Mod             ; $2a2e MOD
	word	BinaryOp_Indirect        ; $2c2f !
	word	Unary_Address            ; $3030 @
	word	Unary_Parenthesis        ; $3031 (
	word	Unary_Hex                ; $3032 &
	word	Unary_Bin                ; $3033 %
	word	ConstShiftHandler        ; $3034 |CONSTSHIFT
	word	Unary_Abs                ; $3035 ABS(
	word	Unary_Alloc              ; $3036 ALLOC(
	word	Unary_Asc                ; $3037 ASC(
	word	Unary_Chr                ; $3038 CHR$(
	word	Unary_Exists             ; $3039 EXISTS(
	word	Unary_False              ; $303a FALSE
	word	Unary_Event              ; $303b EVENT(
	word	Unary_Get                ; $303c GET(
	word	Unary_GetString          ; $303d GET$(
	word	Unary_Hit                ; $303e HIT(
	word	Unary_Inkey              ; $303f INKEY(
	word	Unary_InkeyString        ; $3040 INKEY$(
	word	Dummy113                 ; $3041 INPORT(
	word	Unary_IsNumber           ; $3042 IS.NUMBER(
	word	Command_Jx               ; $3043 JOYX(
	word	Command_Jy               ; $3044 JOYY(
	word	Command_JButton          ; $3045 JOYB(
	word	Unary_Key                ; $3046 KEY(
	word	Unary_Left               ; $3047 LEFT$(
	word	Unary_Len                ; $3048 LEN(
	word	Unary_Lower              ; $3049 LOWER$(
	word	Unary_Mid                ; $304a MID$(
	word	Unary_Max                ; $304b MAX(
	word	Unary_Min                ; $304c MIN(
	word	Unary_Not                ; $304d NOT
	word	Command_Page             ; $304e PAGE
	word	Unary_Peek               ; $304f PEEK(
	word	Unary_Quiet              ; $3050 QUIET(
	word	Unary_Right              ; $3051 RIGHT$(
	word	Unary_Rnd                ; $3052 RND(
	word	Unary_RPL                ; $3053 RPL(
	word	Unary_Sgn                ; $3054 SGN(
	word	Unary_SpriteX            ; $3055 SPRITE.X(
	word	Unary_SpriteY            ; $3056 SPRITE.Y(
	word	Unary_SpriteI            ; $3057 SPRITE.INFO(
	word	Unary_Str                ; $3058 STR$(
	word	Unary_SubCount           ; $3059 SUB.COUNT(
	word	Unary_SubGet             ; $305a SUB.GET$(
	word	Unary_Sys                ; $305b SYS(
	word	Command_SysVar           ; $305c SYSVAR(
	word	Unary_Timer              ; $305d TIMER(
	word	Unary_True               ; $305e TRUE
	word	Unary_Upper              ; $305f UPPER$(
	word	Unary_Val                ; $3060 VAL(
	word	Unary_Len2               ; $3061 LENGTH(
	word	Unary_Rnd2               ; $3062 RANDOM(
	word	Unary_Str2               ; $3063 TO.STRING$(
	word	Unary_Val2               ; $3064 TO.NUMBER(
	word	Unary_Sgn2               ; $3065 SIGN(
	word	Dummy7                   ; $3266 #
	word	Dummy1                   ; $3267 )
	word	Dummy2                   ; $3268 ,
	word	Dummy3                   ; $3269 ;
	word	Dummy4                   ; $326a TO
	word	Dummy5                   ; $326b STEP
	word	Dummy119                 ; $326c ^
	word	Command_FOR              ; $3e6d FOR
	word	Command_If               ; $3e6e IF
	word	Command_Repeat           ; $3e6f REPEAT
	word	Command_While            ; $3e70 WHILE
	word	Command_Proc             ; $3e71 PROC
	word	Dummy115                 ; $3e72 CASE
	word	Command_ENDIF            ; $3a73 ENDIF
	word	Command_Next             ; $3a74 NEXT
	word	Dummy6                   ; $3a75 THEN
	word	Command_Until            ; $3a76 UNTIL
	word	Command_Wend             ; $3a77 WEND
	word	Command_EndProc          ; $3a78 ENDPROC
	word	Dummy116                 ; $3a79 ENDCASE
	word	CommentCommand1          ; $3c7a '
	word	ColonHandler             ; $3c7b :
	word	Command_Print2           ; $3c7c ?
	word	Command_After            ; $3c7d AFTER
	word	CommandAssert            ; $3c7e ASSERT
	word	Command_Blit             ; $3c7f BLIT
	word	Command_Call             ; $3c80 CALL
	word	Command_Cancel           ; $3c81 CANCEL
	word	Command_Clear            ; $3c82 CLEAR
	word	Command_Cls              ; $3c83 CLS
	word	Command_Cursor           ; $3c84 CURSOR
	word	Command_Curve            ; $3c85 CURVE
	word	Dummy112                 ; $3c86 DEFAULT
	word	Command_DIM              ; $3c87 DIM
	word	Command_Dir              ; $3c88 DIR
	word	Command_Draw             ; $3c89 DRAW
	word	Command_Ellipse          ; $3c8a ELLIPSE
	word	Command_ELSE             ; $3c8b ELSE
	word	Command_End              ; $3c8c END
	word	Command_Every            ; $3c8d EVERY
	word	Command_FKey             ; $3c8e FKEY
	word	Dummy9                   ; $3c8f FLIP
	word	Command_Frame            ; $3c90 FRAME
	word	Command_GOSUB            ; $3c91 GOSUB
	word	Command_GOTO             ; $3c92 GOTO
	word	Command_Ink              ; $3c93 INK
	word	Command_Input            ; $3c94 INPUT
	word	Command_Let              ; $3c95 LET
	word	Command_Line             ; $3c96 LINE
	word	Command_List             ; $3c97 LIST
	word	Command_Load             ; $3c98 LOAD
	word	Command_Local            ; $3c99 LOCAL
	word	Dummy204                 ; $3c9a MON
	word	Command_Move             ; $3c9b MOVE
	word	Command_New              ; $3c9c NEW
	word	Command_Old              ; $3c9d OLD
	word	Dummy110                 ; $3c9e ON
	word	Dummy114                 ; $3c9f OUTPORT
	word	Command_Palette          ; $3ca0 PALETTE
	word	Command_Paper            ; $3ca1 PAPER
	word	Command_Plot             ; $3ca2 PLOT
	word	CommandPoke              ; $3ca3 POKE
	word	Command_Print            ; $3ca4 PRINT
	word	SeedHandler              ; $3ca5 RANDOMISE
	word	Command_Rect             ; $3ca6 RECT
	word	CommentCommand2          ; $3ca7 REM
	word	RenumberProgram          ; $3ca8 RENUM
	word	Command_RETURN           ; $3ca9 RETURN
	word	RunProgram               ; $3caa RUN
	word	Command_Save             ; $3cab SAVE
	word	Command_Screen           ; $3cac SCREEN
	word	Command_Slide            ; $3cad SLIDE
	word	Command_Sound            ; $3cae SOUND
	word	Command_Sprite           ; $3caf SPRITE
	word	Command_Stop             ; $3cb0 STOP
	word	CommandSys               ; $3cb1 SYS
	word	Command_Text             ; $3cb2 TEXT
	word	Command_Tile             ; $3cb3 TILE
	word	CommandWait              ; $3cb4 WAIT
	word	Dummy111                 ; $3cb5 WHEN
