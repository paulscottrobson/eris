.TestTokeniserRoutine
	mov r0,#TokenTest
	jsr #TokeniseString
	add r0,#2
	mov r1,#TestResults
	jsr #CompareR0R1
	jmp #$FFFF
.TokenTest
	word $cd31,$c039,$ee30,$ee31,$7836,$7e20,$cb22,$9d42,$1c22,$5620,$a922,$135f,$d943,$fd45,$8963,$e45f,$1922,$a220,$3258,$c172,$4473,$7934,$8471,$f520,$2755,$eb4e,$d254,$1b49,$de4c,$c920,$1726,$1a64,$4961,$8035,$2d61,$6220,$8425,$0631,$a930,$fe30,$ea31,$1b31,$dd31,$9a30,$1b31,$4d31,$9730,$5731,$5631,$8231,$f231,$5a30,$2b31,$ef20,$fe22,$c76e,$8165,$4d3a,$b473,$c95a,$6c7c,$853f,$c16d,$913a,$6a22,$c320,$ae56,$0363,$6720,$8b26,$de64,$7c30,$5737,$1b32,$e420,$6463,$3c6c,$3265,$9761,$0472,$2720,$bb22,$2a7a,$983f,$c45e,$c822,$5720,$c658,$de62,$2c31,$2a20,$3622,$ea6b,$335d,$5c32,$e137,$c057,$cf65,$c622,$b820,$0225,$1931,$be31,$9831,$3231,$3330,$4e30,$c330,$d430,$a831,$8f30,$7a31,$d031,$5831,$d331,$0130,$8f20,$1249,$8720,$2900
.TestResults
	word $ca48,$0103,$0001,$0042,$0105,$0005,$435f,$6345,$005f,$42e8,$44eb,$6011,$3a3c,$3010,$3012,$da5a,$3011,$3012,$9dbd,$0107,$0009,$656e,$733a,$7c5a,$6d3f,$003a,$608e,$3010,$3012,$d072,$3c44,$0104,$0003,$3f7a,$005e,$4068,$601c,$0105,$0006,$5d6b,$3732,$6557,$3011,$f85e,$6009,$0000
