;
;	Automatically generated
;
TOK_MOV = $3200
TOK_LDM = $3201
TOK_STM = $3202
TOK_ADD = $3203
TOK_ADC = $3204
TOK_SUB = $3205
TOK_AND = $2206
TOK_XOR = $2207
TOK_MULT = $3208
TOK_ROR = $3209
TOK_BRL = $320a
TOK_SKEQ = $320b
TOK_SKNE = $320c
TOK_SKSE = $320d
TOK_SKSN = $320e
TOK_SKCM = $320f
TOK_CLR = $3c10
TOK_JMP = $3c11
TOK_JSR = $3c12
TOK_RET = $3c13
TOK_SKZ = $3c14
TOK_SKNZ = $3c15
TOK_SKP = $3c16
TOK_SKM = $3c17
TOK_SKC = $3c18
TOK_SKNC = $3c19
TOK_SKGE = $3c1a
TOK_SKLT = $3c1b
TOK_PUSH = $3c1c
TOK_POP = $3c1d
TOK_CODE = $3c1e
TOK_WORD = $3c1f
TOK_DOT = $3c20
TOK_OR = $2221
TOK_GREATER = $2422
TOK_GREATEREQUAL = $2423
TOK_LESS = $2424
TOK_LESSEQUAL = $2425
TOK_EQUAL = $2426
TOK_LESSGREATER = $2427
TOK_GREATERGREATER = $2628
TOK_LESSLESS = $2629
TOK_PLUS = $282a
TOK_MINUS = $282b
TOK_STAR = $2a2c
TOK_SLASH = $2a2d
TOK_MOD = $2a2e
TOK_PLING = $2c2f
TOK_AT = $3030
TOK_LPAREN = $3031
TOK_AMPERSAND = $3032
TOK_PERCENT = $3033
TOK_VBARCONSTSHIFT = $3034
TOK_ABSLPAREN = $3035
TOK_ALLOCLPAREN = $3036
TOK_ASCLPAREN = $3037
TOK_CHRDOLLARLPAREN = $3038
TOK_EXISTSLPAREN = $3039
TOK_FALSE = $303a
TOK_EVENTLPAREN = $303b
TOK_GETLPAREN = $303c
TOK_GETDOLLARLPAREN = $303d
TOK_HITLPAREN = $303e
TOK_INKEYLPAREN = $303f
TOK_INKEYDOLLARLPAREN = $3040
TOK_INPORTLPAREN = $3041
TOK_ISDOTNUMBERLPAREN = $3042
TOK_JOYXLPAREN = $3043
TOK_JOYYLPAREN = $3044
TOK_JOYBLPAREN = $3045
TOK_KEYLPAREN = $3046
TOK_LEFTDOLLARLPAREN = $3047
TOK_LENLPAREN = $3048
TOK_LOWERDOLLARLPAREN = $3049
TOK_MIDDOLLARLPAREN = $304a
TOK_MAXLPAREN = $304b
TOK_MINLPAREN = $304c
TOK_NOT = $304d
TOK_PAGE = $304e
TOK_PEEKLPAREN = $304f
TOK_QUIETLPAREN = $3050
TOK_RIGHTDOLLARLPAREN = $3051
TOK_RNDLPAREN = $3052
TOK_RPLLPAREN = $3053
TOK_SGNLPAREN = $3054
TOK_SPRITEDOTXLPAREN = $3055
TOK_SPRITEDOTYLPAREN = $3056
TOK_SPRITEDOTINFOLPAREN = $3057
TOK_STRDOLLARLPAREN = $3058
TOK_SUBDOTCOUNTLPAREN = $3059
TOK_SUBDOTGETDOLLARLPAREN = $305a
TOK_SYSLPAREN = $305b
TOK_SYSVARLPAREN = $305c
TOK_TIMERLPAREN = $305d
TOK_TRUE = $305e
TOK_UPPERDOLLARLPAREN = $305f
TOK_VALLPAREN = $3060
TOK_LENGTHLPAREN = $3061
TOK_RANDOMLPAREN = $3062
TOK_TODOTSTRINGDOLLARLPAREN = $3063
TOK_TODOTNUMBERLPAREN = $3064
TOK_SIGNLPAREN = $3065
TOK_HASH = $3266
TOK_RPAREN = $3267
TOK_COMMA = $3268
TOK_SEMICOLON = $3269
TOK_TO = $326a
TOK_STEP = $326b
TOK_HAT = $326c
TOK_FOR = $3e6d
TOK_IF = $3e6e
TOK_REPEAT = $3e6f
TOK_WHILE = $3e70
TOK_PROC = $3e71
TOK_CASE = $3e72
TOK_ENDIF = $3a73
TOK_NEXT = $3a74
TOK_THEN = $3a75
TOK_UNTIL = $3a76
TOK_WEND = $3a77
TOK_ENDPROC = $3a78
TOK_ENDCASE = $3a79
TOK_QUOTE = $3c7a
TOK_COLON = $3c7b
TOK_QMARK = $3c7c
TOK_AFTER = $3c7d
TOK_ASSERT = $3c7e
TOK_BLIT = $3c7f
TOK_CALL = $3c80
TOK_CANCEL = $3c81
TOK_CLEAR = $3c82
TOK_CLS = $3c83
TOK_CURSOR = $3c84
TOK_CURVE = $3c85
TOK_DEFAULT = $3c86
TOK_DIM = $3c87
TOK_DIR = $3c88
TOK_DRAW = $3c89
TOK_ELLIPSE = $3c8a
TOK_ELSE = $3c8b
TOK_END = $3c8c
TOK_EVERY = $3c8d
TOK_FKEY = $3c8e
TOK_FLIP = $3c8f
TOK_FRAME = $3c90
TOK_GOSUB = $3c91
TOK_GOTO = $3c92
TOK_INK = $3c93
TOK_INPUT = $3c94
TOK_LET = $3c95
TOK_LINE = $3c96
TOK_LIST = $3c97
TOK_LOAD = $3c98
TOK_LOCAL = $3c99
TOK_MON = $3c9a
TOK_MOVE = $3c9b
TOK_NEW = $3c9c
TOK_OLD = $3c9d
TOK_ON = $3c9e
TOK_OUTPORT = $3c9f
TOK_PALETTE = $3ca0
TOK_PAPER = $3ca1
TOK_PLOT = $3ca2
TOK_POKE = $3ca3
TOK_PRINT = $3ca4
TOK_RANDOMISE = $3ca5
TOK_RECT = $3ca6
TOK_REM = $3ca7
TOK_RENUM = $3ca8
TOK_RETURN = $3ca9
TOK_RUN = $3caa
TOK_SAVE = $3cab
TOK_SCREEN = $3cac
TOK_SLIDE = $3cad
TOK_SOUND = $3cae
TOK_SPRITE = $3caf
TOK_STOP = $3cb0
TOK_SYS = $3cb1
TOK_TEXT = $3cb2
TOK_TILE = $3cb3
TOK_WAIT = $3cb4
TOK_WHEN = $3cb5
